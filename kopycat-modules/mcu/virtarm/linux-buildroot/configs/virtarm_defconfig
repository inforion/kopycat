## kopycat-modules/mcu/virtarm/linux-buildroot/configs/virtarm_defconfig
```kconfig
BR2_arm=y
BR2_arm1176jz_s=y
BR2_PACKAGE_HOST_LINUX_HEADERS_CUSTOM_REALLY_OLD=y
BR2_GCC_VERSION_4_9_X=y
BR2_ROOTFS_DEVICE_CREATION_STATIC=y
BR2_TARGET_GENERIC_ROOT_PASSWD="toor"
# BR2_TARGET_GENERIC_REMOUNT_ROOTFS_RW is not set
BR2_LINUX_KERNEL=y
BR2_LINUX_KERNEL_CUSTOM_VERSION=y
BR2_LINUX_KERNEL_CUSTOM_VERSION_VALUE="2.6.31.12"
BR2_LINUX_KERNEL_PATCH="patches/linux"
BR2_LINUX_KERNEL_DEFCONFIG="virtarm"
BR2_LINUX_KERNEL_UIMAGE=y
BR2_PACKAGE_BUSYBOX_CONFIG="patches/busybox/busybox.config"
# BR2_PACKAGE_IFUPDOWN_SCRIPTS is not set
BR2_TARGET_ROOTFS_EXT2=y
BR2_TARGET_ROOTFS_EXT2_LABEL="filesystem"
# BR2_TARGET_ROOTFS_TAR is not set
BR2_TARGET_UBOOT=y
BR2_TARGET_UBOOT_BUILD_SYSTEM_KCONFIG=y
BR2_TARGET_UBOOT_CUSTOM_VERSION=y
BR2_TARGET_UBOOT_CUSTOM_VERSION_VALUE="2017.11"
BR2_TARGET_UBOOT_PATCH="patches/u-boot"
BR2_TARGET_UBOOT_BOARD_DEFCONFIG="virtarm"
```
