# file: freertos_uart.ioc
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Mcu.Family=STM32F0
RCC.Usart1ClockSelection=RCC_USART1CLKSOURCE_SYSCLK
RCC.PLLSourceVirtual=RCC_PLLSOURCE_HSI48
FREERTOS.Tasks01=starterTask,0,128,StarterTaskHandler,Default,NULL,Static,starterTaskBuffer,starterTaskControlBlock;uartTask,0,128,UartTaskHandler,Default,NULL,Static,uartTaskBuffer,uartTaskControlBlock;processTask,0,128,ProcessTaskHandler,Default,NULL,Static,processTaskBuffer,processTaskControlBlock;watchDogTask,0,128,WatchDogHandler,Default,NULL,Static,watchDogBuffer,watchDogControlBlock
VP_SYS_VS_tim1.Mode=TIM1
FREERTOS.HEAP_NUMBER=2
USART1.BaudRate=115200
VP_FREERTOS_VS_CMSIS_V1.Mode=CMSIS_V1
Mcu.Name=STM32F042K(4-6)Tx
FREERTOS.configTOTAL_HEAP_SIZE=0xc00
RCC.SYSCLKFreq_VALUE=48000000
Mcu.Package=LQFP32
RCC.SYSCLKSource=RCC_SYSCLKSOURCE_HSI48
ProjectManager.StackSize=0x100
NVIC.TimeBase=TIM1_BRK_UP_TRG_COM_IRQn
USART1.VirtualMode-Half_duplex(single_wire_mode)=VM_ASYNC
PA9.Mode=Half_duplex(single_wire_mode)
NVIC.TimeBaseIP=TIM1
ProjectManager.HeapSize=0x0
ProjectManager.TargetToolchain=SW4STM32
RCC.HCLKFreq_Value=48000000
PA9.Signal=USART1_TX
RCC.APB1TimFreq_Value=48000000
RCC.APB1Freq_Value=48000000
RCC.AHBFreq_Value=48000000
NVIC.TIM1_BRK_UP_TRG_COM_IRQn=true\:0\:0\:false\:false\:true\:false\:false\:true
FREERTOS.MEMORY_ALLOCATION=1
board=custom

// file: Src/main.c
/* USER CODE BEGIN Header */
/**
  ******************************************************************************
  * @file           : main.c
  * @brief          : Main program body
  ******************************************************************************
  * @attention
  *
  * <h2><center>&copy; Copyright (c) 2020 STMicroelectronics.
  * All rights reserved.</center></h2>
  *
  * This software component is licensed by ST under Ultimate Liberty license
  * SLA0044, the "License"; You may not use this file except in compliance with
  * the License. You may obtain a copy of the License at:
  *                             www.st.com/SLA0044
  *
  ******************************************************************************
  */
/* USER CODE END Header */

#include "main.h"
#include "cmsis_os.h"

/* USER CODE BEGIN Includes */
#include "tinyprintf.h"
/* USER CODE END Includes */

UART_HandleTypeDef huart1;

osThreadId starterTaskHandle;
uint32_t starterTaskBuffer[ 128 ];
osStaticThreadDef_t starterTaskControlBlock;
osThreadId uartTaskHandle;
uint32_t uartTaskBuffer[ 128 ];
osStaticThreadDef_t uartTaskControlBlock;
osThreadId processTaskHandle;
uint32_t processTaskBuffer[ 128 ];
osStaticThreadDef_t processTaskControlBlock;
osThreadId watchDogTaskHandle;
uint32_t watchDogBuffer[ 128 ];
osStaticThreadDef_t watchDogControlBlock;

void SystemClock_Config(void);
static void MX_GPIO_Init(void);
static void MX_USART1_UART_Init(void);
void StarterTaskHandler(void const * argument);
void UartTaskHandler(void const * argument);
void ProcessTaskHandler(void const * argument);
void WatchDogHandler(void const * argument);

/* USER CODE BEGIN 0 */
static void uart_putf(void *unused, char c) {
    HAL_StatusTypeDef status;
    do {
        status = HAL_UART_Transmit(&huart1, (uint8_t*)&c, 1, 1000);
    } while (status == HAL_BUSY);
}

static void uart_printf_enter(void) {
    osThreadSuspendAll();
}

static void uart_printf_exit(void) {
    osThreadResumeAll();
}
/* USER CODE END 0 */

int main(void)
{
  /* USER CODE BEGIN 1 */
    init_printf(NULL, uart_putf, uart_printf_enter, uart_printf_exit);
  /* USER CODE END 1 */

  /* MCU Configuration--------------------------------------------------------*/

  /* Reset of all peripherals, Initializes the Flash interface and the Systick. */
  HAL_Init();

  /* Configure the system clock */
  SystemClock_Config();

  /* Initialize all configured peripherals */
  MX_GPIO_Init();
  MX_USART1_UART_Init();

  /* Create the thread(s) */
  /* definition and creation of starterTask */
  osThreadStaticDef(starterTask, StarterTaskHandler, osPriorityNormal, 0, 128, starterTaskBuffer, &starterTaskControlBlock);
  starterTaskHandle = osThreadCreate(osThread(starterTask), NULL);

  /* definition and creation of uartTask */
  osThreadStaticDef(uartTask, UartTaskHandler, osPriorityNormal, 0, 128, uartTaskBuffer, &uartTaskControlBlock);
  uartTaskHandle = osThreadCreate(osThread(uartTask), NULL);

  /* definition and creation of processTask */
  osThreadStaticDef(processTask, ProcessTaskHandler, osPriorityNormal, 0, 128, processTaskBuffer, &processTaskControlBlock);
  processTaskHandle = osThreadCreate(osThread(processTask), NULL);

  /* definition and creation of watchDogTask */
  osThreadStaticDef(watchDogTask, WatchDogHandler, osPriorityNormal, 0, 128, watchDogBuffer, &watchDogControlBlock);
  watchDogTaskHandle = osThreadCreate(osThread(watchDogTask), NULL);

  /* Start scheduler */
  osKernelStart();

  /* We should never get here as control is now taken by the scheduler */
  /* Infinite loop */
  while (1)
  {

  }
}

void SystemClock_Config(void)
{
  RCC_OscInitTypeDef RCC_OscInitStruct = {0};
  RCC_ClkInitTypeDef RCC_ClkInitStruct = {0};
  RCC_PeriphCLKInitTypeDef PeriphClkInit = {0};

  /** Initializes the CPU, AHB and APB busses clocks
  */
  RCC_OscInitStruct.OscillatorType = RCC_OSCILLATORTYPE_HSI48;
  RCC_OscInitStruct.HSI48State = RCC_HSI48_ON;
  RCC_OscInitStruct.PLL.PLLState = RCC_PLL_NONE;
  if (HAL_RCC_OscConfig(&RCC_OscInitStruct) != HAL_OK)
  {
    Error_Handler();
  }
  /** Initializes the CPU, AHB and APB busses clocks
  */
  RCC_ClkInitStruct.ClockType = RCC_CLOCKTYPE_HCLK|RCC_CLOCKTYPE_SYSCLK
                              |RCC_CLOCKTYPE_PCLK1;
  RCC_ClkInitStruct.SYSCLKSource = RCC_SYSCLKSOURCE_HSI48;
  RCC_ClkInitStruct.AHBCLKDivider = RCC_SYSCLK_DIV1;
  RCC_ClkInitStruct.APB1CLKDivider = RCC_HCLK_DIV1;

  if (HAL_RCC_ClockConfig(&RCC_ClkInitStruct, FLASH_LATENCY_1) != HAL_OK)
  {
    Error_Handler();
  }
  PeriphClkInit.PeriphClockSelection = RCC_PERIPHCLK_USART1;
  PeriphClkInit.Usart1ClockSelection = RCC_USART1CLKSOURCE_SYSCLK;
  if (HAL_RCCEx_PeriphCLKConfig(&PeriphClkInit) != HAL_OK)
  {
    Error_Handler();
  }
}

static void MX_USART1_UART_Init(void)
{

  huart1.Instance = USART1;
  huart1.Init.BaudRate = 115200;
  huart1.Init.WordLength = UART_WORDLENGTH_8B;
  huart1.Init.StopBits = UART_STOPBITS_1;
  huart1.Init.Parity = UART_PARITY_NONE;
  huart1.Init.Mode = UART_MODE_TX_RX;
  huart1.Init.HwFlowCtl = UART_HWCONTROL_NONE;
  huart1.Init.OverSampling = UART_OVERSAMPLING_16;
  huart1.Init.OneBitSampling = UART_ONE_BIT_SAMPLE_DISABLE;
  huart1.AdvancedInit.AdvFeatureInit = UART_ADVFEATURE_NO_INIT;
  if (HAL_HalfDuplex_Init(&huart1) != HAL_OK)
  {
    Error_Handler();
  }

}

static void MX_GPIO_Init(void)
{

  /* GPIO Ports Clock Enable */
  __HAL_RCC_GPIOA_CLK_ENABLE();

}

void StarterTaskHandler(void const * argument)
{
  /* USER CODE BEGIN 5 */
    printf("StarterTaskHandler start!\n");
  /* Infinite loop */
  for(int k = 0; k < 128; k++) {
      printf("StarterTaskHandler: %d\n", k);
      osDelay(1);
  }
  osThreadSuspend(starterTaskHandle);
  /* USER CODE END 5 */
}

void UartTaskHandler(void const * argument)
{
  /* USER CODE BEGIN UartTaskHandler */
    printf("UartTaskHandler started!\n");
  /* Infinite loop */
    for(int k = 0; k < 128; k++) {
        printf("UartTaskHandler: %d\n", k);
        osDelay(1);
    }
    osThreadSuspend(uartTaskHandle);
  /* USER CODE END UartTaskHandler */
}

void ProcessTaskHandler(void const * argument)
{
  /* USER CODE BEGIN ProcessTaskHandler */
    printf("ProcessTaskHandler started!\n");
  /* Infinite loop */
    for(int k = 0; k < 128; k++) {
        printf("ProcessTaskHandler: %d\n", k);
        osDelay(1);
    }
    osThreadSuspend(processTaskHandle);
  /* USER CODE END ProcessTaskHandler */
}

void WatchDogHandler(void const * argument)
{
  /* USER CODE BEGIN WatchDogHandler */
    printf("WatchDogHandler started!\n");
  /* Infinite loop */
    for(int k = 0; k < 128; k++) {
        printf("WatchDogHandler: %d\n", k);
        osDelay(1);
    }

    osDelay(100);

    while (1) {
        osDelay(1);
    }
  /* USER CODE END WatchDogHandler */
}

 /**
  * @brief  Period elapsed callback in non blocking mode
  * @note   This function is called  when TIM1 interrupt took place, inside
  * HAL_TIM_IRQHandler(). It makes a direct call to HAL_IncTick() to increment
  * a global variable "uwTick" used as application time base.
  * @param  htim : TIM handle
  * @retval None
  */
void HAL_TIM_PeriodElapsedCallback(TIM_HandleTypeDef *htim)
{
  if (htim->Instance == TIM1) {
    HAL_IncTick();
  }
}

void Error_Handler(void)
{
}

/************************ (C) COPYRIGHT STMicroelectronics *****END OF FILE****/

// file: Src/freertos.c
/* USER CODE BEGIN Header */
/**
  ******************************************************************************
  * File Name          : freertos.c
  * Description        : Code for freertos applications
  ******************************************************************************
  * @attention
  *
  * <h2><center>&copy; Copyright (c) 2020 STMicroelectronics.
  * All rights reserved.</center></h2>
  *
  * This software component is licensed by ST under Ultimate Liberty license
  * SLA0044, the "License"; You may not use this file except in compliance with
  * the License. You may obtain a copy of the License at:
  *                             www.st.com/SLA0044
  *
  ******************************************************************************
  */
/* USER CODE END Header */

#include "FreeRTOS.h"
#include "task.h"
#include "main.h"

/* GetIdleTaskMemory prototype (linked to static allocation support) */
void vApplicationGetIdleTaskMemory( StaticTask_t **ppxIdleTaskTCBBuffer, StackType_t **ppxIdleTaskStackBuffer, uint32_t *pulIdleTaskStackSize );

/* USER CODE BEGIN GET_IDLE_TASK_MEMORY */
static StaticTask_t xIdleTaskTCBBuffer;
static StackType_t xIdleStack[configMINIMAL_STACK_SIZE];

void vApplicationGetIdleTaskMemory( StaticTask_t **ppxIdleTaskTCBBuffer, StackType_t **ppxIdleTaskStackBuffer, uint32_t *pulIdleTaskStackSize )
{
  *ppxIdleTaskTCBBuffer = &xIdleTaskTCBBuffer;
  *ppxIdleTaskStackBuffer = &xIdleStack[0];
  *pulIdleTaskStackSize = configMINIMAL_STACK_SIZE;
  /* place for user code */
}
/* USER CODE END GET_IDLE_TASK_MEMORY */

/************************ (C) COPYRIGHT STMicroelectronics *****END OF FILE****/
